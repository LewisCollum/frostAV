/dts-v1/;
/plugin/;
/ {
	fragment@0 {
		target = <&i2c1>;
		__overlay__ {
			status = "okay";
			ina226@40 {	
				compatible = "ti,ina226";
				reg = <0x40>;
				shunt-resistor = <2000>;
			};
		};
	};
};

